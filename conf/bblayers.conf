## conf/bblayers.conf
```bitbake
# POKY_BBLAYERS_CONF_VERSION is increased each time build/conf/bblayers.conf
# changes incompatibly
POKY_BBLAYERS_CONF_VERSION = "2"

BBPATH = "${TOPDIR}"
BBFILES ?= ""

BBLAYERS ?= " \
  /home/ram/My_Device/yocto/poky/meta \
  /home/ram/My_Device/yocto/poky/meta-poky \
  /home/ram/My_Device/yocto/poky/meta-yocto-bsp \
  ${TOPDIR}/../meta-raspberrypi \
  ${TOPDIR}/../../meta-openembedded/meta-oe \
  /home/ram/My_Device/yocto/poky/meta-mycustom \
  ${TOPDIR}/../meta-qt5 \
  "
```
